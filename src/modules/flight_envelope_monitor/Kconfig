## src/modules/flight_envelope_monitor/Kconfig
```kconfig
menuconfig MODULES_FLIGHT_ENVELOPE_MONITOR
	bool "flight_envelope_monitor"
	default n
	---help---
		Enable support for the advisory flight-test envelope monitor
```
